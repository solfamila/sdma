Break.Delete
Break.Set capture_chunk_validate_failure /Program
Break.Set capture_failure_snapshot /Program
Break.Set set_failure_led /Program
Break.Set set_success_led /Program

Go
WAIT !STATE.RUN() 5.s
IF STATE.RUN()
(
  Break
  WAIT !STATE.RUN() 1.s
)
ENDDO